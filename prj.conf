## CMakeLists.txt
```
#
# Copyright (c) 2019 Nordic Semiconductor
#
# SPDX-License-Identifier: LicenseRef-Nordic-5-Clause
#

cmake_minimum_required(VERSION 3.20.0)

find_package(Zephyr REQUIRED HINTS $ENV{ZEPHYR_BASE})
project(cellular_fundamentals)

# NORDIC SDK APP START
target_sources(app PRIVATE src/main.c)
# NORDIC SDK APP END

# Add include directory for board specific CAF def files
target_include_directories(app PRIVATE configuration/${BOARD}/)

target_include_directories(app PRIVATE src)

target_sources(app PRIVATE
		src/events/app_module_event.c
)

# Application directories
add_subdirectory(src/modules)
add_subdirectory(src/events)
```

## Kconfig
```
#
# Copyright (c) 2019 Nordic Semiconductor ASA
#
# SPDX-License-Identifier: LicenseRef-Nordic-5-Clause
#

menu "Iot-miniproject-2"

config GNSS_PERIODIC_INTERVAL
	int "Fix interval for periodic GPS fixes"
	range 10 65535
	default 120
	help
	  Fix interval (in seconds) for periodic fixes.

config GNSS_PERIODIC_TIMEOUT
	int "Fix timeout for periodic GPS fixes"
	range 0 65535
	default 480
	help
	  Fix timeout (in seconds) for periodic fixes.
	  If set to zero, GNSS is allowed to run indefinitely until a valid PVT estimate is produced.

config COAP_SERVER_IP
	string "CoAP server ip address"

config COAP_SERVER_PORT
	int "CoAP server port"
	default 5683

config COAP_DATA_RESOURCE
	string "CoAP resource - this is the TX channel of the board"
	default "large-update"

config COAP_DEVICE_CONFIG_RESOURCE
	string "CoAP resource - this is the RX channel of the board"
	default "validate"

rsource "src/modules/Kconfig.modem_module"

endmenu

menu "Zephyr Kernel"
source "Kconfig.zephyr"
endmenu

module = APPLICATION_MODULE
module-str = Application module
source "subsys/logging/Kconfig.template.log_config"
```

## prj.conf
```kconfig
#
# Copyright (c) 2019 Nordic Semiconductor ASA
#
# SPDX-License-Identifier: LicenseRef-Nordic-5-Clause
#

# General configuration
CONFIG_FPU=y
CONFIG_NEWLIB_LIBC=y
CONFIG_NEWLIB_LIBC_FLOAT_PRINTF=y
CONFIG_NRF_MODEM_LIB=y

# Heap and memory pool configuration
CONFIG_HEAP_MEM_POOL_SIZE=8192
CONFIG_MAIN_STACK_SIZE=4096
CONFIG_SYSTEM_WORKQUEUE_STACK_SIZE=4096
CONFIG_HW_STACK_PROTECTION=y
# Increase AT monitor heap because %NCELLMEAS notifications can be large
CONFIG_AT_MONITOR_HEAP_SIZE=512

# Logging
CONFIG_LOG=y
CONFIG_LOG_MODE_IMMEDIATE=y

# AT commands
CONFIG_AT_HOST_LIBRARY=y
CONFIG_UART_INTERRUPT_DRIVEN=y

# Network
CONFIG_NETWORKING=y
CONFIG_NET_NATIVE=n
CONFIG_NET_SOCKETS=y
CONFIG_NET_SOCKETS_OFFLOAD=y
CONFIG_NET_SOCKETS_POSIX_NAMES=y

# LTE link control
CONFIG_LTE_LINK_CONTROL=y
CONFIG_LTE_NETWORK_MODE_LTE_M_NBIOT_GPS=y
# Request eDRX from the network
# CONFIG_LTE_EDRX_REQ=y
# Request PSM periodic TAU and active time
CONFIG_LTE_PSM_REQ_RPTAU="00101010"
CONFIG_LTE_PSM_REQ_RAT="00100001"

# Application Event Manager
CONFIG_APP_EVENT_MANAGER=y
CONFIG_APP_EVENT_MANAGER_LOG_EVENT_TYPE=n

# Button and LED support
CONFIG_DK_LIBRARY=y

# Dependencies for CAF_LEDS
CONFIG_CAF=y
CONFIG_LED=y
CONFIG_PWM=y
CONFIG_LED_PWM=y

# Enable CAF_LEDS
CONFIG_CAF_LEDS=y
CONFIG_CAF_LEDS_PWM=y

# Location related configuration
CONFIG_LOCATION=y
# CONFIG_LOCATION_REQUEST_DEFAULT_METHOD_FIRST_GNSS=y
# # CONFIG_LOCATION_REQUEST_DEFAULT_METHOD_SECOND_CELLULAR=y
# CONFIG_LOCATION_REQUEST_DEFAULT_GNSS_TIMEOUT=90000
CONFIG_LOCATION_DATA_DETAILS=y
# CONFIG_LOCATION_LOG_LEVEL_WRN=y

# nRF Cloud (for A-GNSS and cell location)
CONFIG_NRF_CLOUD_REST=y
CONFIG_NRF_CLOUD_AGNSS=y
CONFIG_MODEM_INFO=y # required by CONFIG_NRF_CLOUD_AGNSS
CONFIG_MODEM_INFO_ADD_NETWORK=y # required by CONFIG_NRF_CLOUD_AGNSS

# Library that maintains the current date time UTC for A-GNSS and P-GPS purposes
CONFIG_DATE_TIME=y

# Modem JWT
CONFIG_MODEM_JWT=y

# CoAP
# Enable the CoAP library
CONFIG_COAP=y

# Configure the CoAP server ip address
CONFIG_COAP_SERVER_IP="34.88.232.103"

# Configure the CoAP resource for TX and RX communication
CONFIG_COAP_DATA_RESOURCE="data"
CONFIG_COAP_DEVICE_CONFIG_RESOURCE="device_config"

# Enable the modem trace library
CONFIG_NRF_MODEM_LIB_TRACE=y

# cJSON - Used in cloud data encoding.
CONFIG_CJSON_LIB=y
```

## src/main.c
```c
#include <stdio.h>
#include <time.h>

#include <zephyr/kernel.h>
#include <zephyr/net/socket.h>
#include <zephyr/random/rand32.h>

#include <zephyr/logging/log.h>
#include <dk_buttons_and_leds.h>
#include <modem/nrf_modem_lib.h>
#include <zephyr/sys/reboot.h>
#include <modem/lte_lc.h>
#include <nrf_modem_gnss.h>

#include "codec.h"

#include <app_event_manager.h>
#include <app_event_manager_profiler_tracer.h>

#define MODULE main
#include <caf/events/module_state_event.h>

#include "modules/modules_common.h"
#include "events/app_module_event.h"
#include "events/cloud_module_event.h"
#include "events/modem_module_event.h"
#include "events/location_module_event.h"

/* Application module super states. */
static enum state_type {
	STATE_INIT,
	STATE_RUNNING,
	STATE_SHUTDOWN
} state;

/* Application sub states. The application can be in either active or passive
 * mode.
 *
 * Active mode: Sensor GNSS position is acquired at a configured
 *		interval and sent to cloud.
 *
 * Passive mode: Sensor GNSS position is acquired when movement is
 *		 detected, or after the configured movement timeout occurs.
 *		 Movement detection is not yet implemented.
 */
static enum sub_state_type {
	SUB_STATE_ACTIVE_MODE,
	SUB_STATE_PASSIVE_MODE,
} sub_state;

static struct app_cfg current_cfg = {
	.device_id = 0,
	.active_mode = true,
	.location_timeout = 300,
	.active_wait_timeout = 120,
	.passive_wait_timeout = 3600
};

struct app_msg_data {
	union {
		struct app_module_event app;
		struct cloud_module_event cloud;
		struct modem_module_event modem;
		struct location_module_event location;
	} module;
};

static void data_sample_timer_handler(struct k_timer *timer_id);

#define MSG_Q_SIZE 20

K_MSGQ_DEFINE(msgq_app, sizeof(struct app_msg_data), MSG_Q_SIZE, 4);

LOG_MODULE_REGISTER(MODULE, LOG_LEVEL_DBG);

/* Data sample timer used in ative mode*/
K_TIMER_DEFINE(data_sample_timer, data_sample_timer_handler, NULL);

static char *sub_state_to_string(enum sub_state_type sub_state)
{
	switch (sub_state)
	{
	case SUB_STATE_ACTIVE_MODE:
		return "SUB_STATE_ACTIVE_MODE";
	case SUB_STATE_PASSIVE_MODE:
		return "SUB_STATE_PASSIVE_MODE";
	default:
		return "Unknown";
	}
}

static char *state_to_string(enum state_type state)
{
	switch (state)
	{
	case STATE_INIT:
		return "STATE_INIT";
	case STATE_RUNNING:
		return "STATE_RUNNING";
	case STATE_SHUTDOWN:
		return "STATE_SHUTDOWN";
	default:
		return "Unknown";
	}
}

static void set_state(enum state_type new_state)
{
	if (new_state == state) {
		LOG_DBG("State: %s", state_to_string(state));
		return;
	}
	LOG_DBG("State transition: %s -> %s", 
		state_to_string(state),
		state_to_string(new_state));
	state = new_state;
}

static void set_sub_state(enum sub_state_type new_sub_state)
{
	if (new_sub_state == sub_state) {
		LOG_DBG("Sub state: %s", state_to_string(sub_state));
		return;
	}
	LOG_DBG("Sub state transition: %s -> %s", 
		sub_state_to_string(sub_state),
		sub_state_to_string(new_sub_state));
	sub_state = new_sub_state;
}

static void set_passive_mode_timer(void)
{
	LOG_INF("Setting passive mode timer to %ds", current_cfg.passive_wait_timeout);
	k_timer_start(&data_sample_timer, K_SECONDS(current_cfg.passive_wait_timeout), K_SECONDS(current_cfg.passive_wait_timeout));
}

static void set_active_mode_timer(void)
{
	LOG_INF("Setting active mode timer to %ds", current_cfg.active_wait_timeout);
	k_timer_start(&data_sample_timer, K_SECONDS(current_cfg.active_wait_timeout), K_SECONDS(current_cfg.active_wait_timeout));
}

static bool app_event_handler(const struct app_event_header *aeh){
	bool consume = false, enqueue_msg = false;
	struct app_msg_data msg = {0};
	if (is_app_module_event(aeh)){
		struct app_module_event *event = cast_app_module_event(aeh);
		msg.module.app = *event;
		enqueue_msg = true;
	}
	
	if (is_cloud_module_event(aeh)){
		struct cloud_module_event *event = cast_cloud_module_event(aeh);
		msg.module.cloud = *event;
		enqueue_msg = true;
	}
	
	if (is_modem_module_event(aeh)){
		struct modem_module_event *event = cast_modem_module_event(aeh);
		msg.module.modem = *event;
		enqueue_msg = true;
	}
	
	if (is_location_module_event(aeh)){
		struct location_module_event *event = cast_location_module_event(aeh);
		msg.module.location = *event;
		enqueue_msg = true;
	}

	if (enqueue_msg){
		 /* Add the event to the message queue */
        int err = k_msgq_put(&msgq_app, &msg, K_NO_WAIT);
        if (err) {
            LOG_ERR("Failed to add event to message queue: %d", err);
            /* Handle the error */
        }
	}

	return consume;
}

static void data_sample_timer_handler(struct k_timer *timer_id)
{
	LOG_INF("Data sample timer expired");
	struct app_module_event *app_module_event = new_app_module_event();
	app_module_event->type = APP_EVENT_LOCATION_GET;
	APP_EVENT_SUBMIT(app_module_event);
	if (current_cfg.active_mode) {
		set_active_mode_timer();
	} else {
		set_passive_mode_timer();
	}
}

static void handle_new_config(struct app_cfg *new_cfg){
	bool config_change = false;
	if (current_cfg.active_mode != new_cfg->active_mode){
		current_cfg.active_mode = new_cfg->active_mode;
		if (current_cfg.active_mode){
			LOG_DBG("New Device mode: Active");
		} else {
			LOG_DBG("New Device mode: Passive");
		}
		config_change = true;
	}

	if (new_cfg->active_wait_timeout > 0){
		if (current_cfg.active_wait_timeout != new_cfg->active_wait_timeout){
			current_cfg.active_wait_timeout = new_cfg->active_wait_timeout;
			LOG_DBG("New active wait timeout: %d", current_cfg.active_wait_timeout);
			config_change = true;
		}
	} else {
		LOG_WRN("New active wait timeout out of range: %d", new_cfg->active_wait_timeout);
	}

	if (new_cfg->location_timeout > 0){
		if (current_cfg.location_timeout != new_cfg->location_timeout){
			current_cfg.location_timeout = new_cfg->location_timeout;
			LOG_DBG("New location timeout: %d", current_cfg.location_timeout);
			config_change = true;
		}
	} else {
		LOG_WRN("New location timeout out of range: %d", new_cfg->location_timeout);
	}

	if (new_cfg->passive_wait_timeout > 0){
		if (current_cfg.passive_wait_timeout != new_cfg->passive_wait_timeout){
			current_cfg.passive_wait_timeout = new_cfg->passive_wait_timeout;
			LOG_DBG("New passive wait timeout: %d", current_cfg.passive_wait_timeout);
			config_change = true;
		}
	} else {
		LOG_WRN("New passive wait timeout out of range: %d", new_cfg->passive_wait_timeout);
	}

	if (config_change){
		//TODO Save config to flash

		struct app_module_event *app_module_event = new_app_module_event();
		app_module_event->type = APP_EVENT_CONFIG_UPDATE;
		app_module_event->app_cfg = current_cfg;
		APP_EVENT_SUBMIT(app_module_event);
	} else {
		LOG_DBG("New config is identical to old config!");
	}
}

static void on_state_init(struct app_msg_data *msg)
{
	set_state(STATE_RUNNING);
	if (current_cfg.active_mode) {
		set_sub_state(SUB_STATE_ACTIVE_MODE);
		set_active_mode_timer();
	} else {
		set_sub_state(SUB_STATE_PASSIVE_MODE);
		set_passive_mode_timer();
	}
}

static void on_state_running(struct app_msg_data *msg)
{	
	// flag used to trigger data request, when connected to the cloud for the first time
	static bool initial_data_request;

	if (IS_EVENT(msg, cloud, CLOUD_EVENT_SERVER_CONNECTED) && !initial_data_request){
		struct app_module_event *app_module_event = new_app_module_event();
		app_module_event->type = APP_EVENT_LOCATION_GET;
		APP_EVENT_SUBMIT(app_module_event);

		initial_data_request = true;
	}
}

static void on_sub_state_active(struct app_msg_data *msg)
{
	if (IS_EVENT(msg, app, APP_EVENT_CONFIG_UPDATE)){
		if (current_cfg.active_mode){
			set_active_mode_timer();
			return;
		}
		set_passive_mode_timer();
		set_sub_state(SUB_STATE_PASSIVE_MODE);
	}
}

static void on_sub_state_passive(struct app_msg_data *msg)
{
	if (IS_EVENT(msg, app, APP_EVENT_CONFIG_UPDATE)){
		if (current_cfg.active_mode){
			set_active_mode_timer();
			set_sub_state(SUB_STATE_ACTIVE_MODE);
			return;
		}
		set_passive_mode_timer();
	}
}

static void on_all_states(struct app_msg_data *msg)
{
	if (IS_EVENT(msg, cloud, CLOUD_EVENT_CLOUD_CONFIG_RECEIVED)){
		struct app_cfg new_cfg = msg->module.cloud.cloud_cfg;
		handle_new_config(&new_cfg);
	}
}

int main(void)
{	
	int err;
	struct app_msg_data msg = {0};

	k_sleep(K_SECONDS(3));

	LOG_INF("Application started");

	if (app_event_manager_init()) {
		LOG_ERR("Application Event Manager could not be initialized, rebooting...");
		k_sleep(K_SECONDS(5));
		sys_reboot(SYS_REBOOT_COLD);
	} else {
		LOG_INF("Application Event Manager initialized");
		module_set_state(MODULE_STATE_READY);
		struct app_module_event *app_module_event = new_app_module_event();
		app_module_event->type = APP_EVENT_START;
		app_module_event->app_cfg = current_cfg;
		APP_EVENT_SUBMIT(app_module_event);
	}

	while (1)
	{	
        err = k_msgq_get(&msgq_app, &msg, K_FOREVER);
		if (err) {
            LOG_ERR("Failed to get event from message queue: %d", err);
            /* Handle the error */
        } else {

			switch (state)
			{
			case STATE_INIT:
				on_state_init(&msg);
				break;
			case STATE_RUNNING:
				switch (sub_state)
				{
				case SUB_STATE_ACTIVE_MODE:
					on_sub_state_active(&msg);
					break;
				case SUB_STATE_PASSIVE_MODE:
					on_sub_state_passive(&msg);
					break;
				default:
					break;
				}
				on_state_running(&msg);
				break;
			case STATE_SHUTDOWN:
				break;
			
			default:
				LOG_ERR("Unknown state");
				break;
			}
			on_all_states(&msg);
		}
	}

	return 0;
}

APP_EVENT_LISTENER(MODULE, app_event_handler);
APP_EVENT_SUBSCRIBE(MODULE, app_module_event);
APP_EVENT_SUBSCRIBE(MODULE, modem_module_event);
APP_EVENT_SUBSCRIBE(MODULE, cloud_module_event);
APP_EVENT_SUBSCRIBE(MODULE, location_module_event);
```

## src/codec.h
```c
#ifndef CODEC_H__
#define CODEC_H__

#include <stdbool.h>

#ifdef __cplusplus
extern "C" {
#endif

struct app_cfg{
	/**Device id for identifying the device*/
	int device_id;
	/**Device mode: Active or Passive*/
	bool active_mode;
	/**Location search timeout*/
	int location_timeout;
	/**Delay between location search in active mode*/
	int active_wait_timeout;
	/**Delay between location search in passive mode*/
	int passive_wait_timeout;
};

#ifdef __cplusplus
}
#endif
#endif
```
